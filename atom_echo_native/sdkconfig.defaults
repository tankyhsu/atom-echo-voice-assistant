## atom_echo_native/sdkconfig.defaults
```kconfig
# WiFi (these are overridden by the wifi_list[] in main.cc)
CONFIG_ESP_WIFI_SSID="your_wifi_ssid"
CONFIG_ESP_WIFI_PASSWORD="your_wifi_password"

# Stack sizes
CONFIG_ESP_MAIN_TASK_STACK_SIZE=8192
CONFIG_ESP_SYSTEM_EVENT_TASK_STACK_SIZE=4096

# Log level
CONFIG_LOG_DEFAULT_LEVEL_INFO=y

# I2S
CONFIG_SOC_I2S_SUPPORTS_TDM=n

# Partition table (custom, 3MB app)
CONFIG_PARTITION_TABLE_CUSTOM=y
CONFIG_PARTITION_TABLE_CUSTOM_FILENAME="partitions.csv"

# Performance
CONFIG_FREERTOS_HZ=1000
```
